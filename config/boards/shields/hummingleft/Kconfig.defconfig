## config/boards/shields/hummingleft/Kconfig.shield
```kconfig
# No whitespace after the comma or in your part name!
config SHIELD_HUMMINGLEFT
    def_bool $(shields_list_contains,hummingleft)

# No whitespace after the comma or in your part name!
config SHIELD_HUMMINGRIGHT
    def_bool $(shields_list_contains,hummingright)
```
